## yocto/meta-zynq/conf/distro/zynq.conf
```bitbake
require conf/distro/poky.conf

MAINTAINER = "Andreas Galauner <andreas@galauner.de>"
DISTRO_NAME = "Zynq custom distro"
DISTRO_VERSION = "1.0.0"
DISTRO_CODENAME = "zynq"
DISTRO_FEATURES = "acl ipv4 ipv6 largefile xattr systemd remoteproc x11 ${DISTRO_FEATURES_LIBC}" 

VIRTUAL-RUNTIME_init_manager = "systemd"
VIRTUAL-RUNTIME_initscripts = "systemd-compat-units"
DISTRO_FEATURES_BACKFILL_CONSIDERED = "sysvinit"

# Prevent stacking up hundreds of old builds by not including a DATETIME in the image name
IMAGE_NAME = "${IMAGE_BASENAME}-${MACHINE}"
```

## yocto/meta-zynq/conf/machine/autocopter-microzed-iocc-zynq7.conf
```bitbake
#@TYPE: Machine
#@NAME: autocopter-microzed-iocc-zynq7
#@DESCRIPTION: Machine support for Microzed IOCC
require include/microzed.inc
require include/autocopter.inc
```

## yocto/meta-zynq/conf/machine/autocopter-picozed-pciecc-zynq7.conf
```bitbake
#@TYPE: Machine
#@NAME: autocopter-picozed-pciecc-zynq7
#@DESCRIPTION: Machine support for Autocopter Picozed PCIeCC
require include/picozed.inc
require include/autocopter.inc
```

## yocto/meta-zynq/conf/machine/base-crz01-carrier-zynq7.conf
```bitbake
#@TYPE: Machine
#@NAME: base-crz01-carrier-zynq7
#@DESCRIPTION: Machine support for GVI-Tech CRZ01 on carrier
require include/crz01.inc

MACHINE_ESSENTIAL_EXTRA_RRECOMMENDS += "\
	kernel-modules \
	"
```

## yocto/meta-zynq/conf/machine/base-microzed-iocc-zynq7.conf
```bitbake
#@TYPE: Machine
#@NAME: base-microzed-iocc-zynq7
#@DESCRIPTION: Machine support for Microzed IOCC
require include/microzed.inc

MACHINE_ESSENTIAL_EXTRA_RRECOMMENDS += "\
	kernel-modules \
	"
```

## yocto/meta-zynq/conf/machine/base-picozed-pciecc-zynq7.conf
```bitbake
#@TYPE: Machine
#@NAME: base-picozed-pciecc-zynq7
#@DESCRIPTION: Machine support for Picozed PCIeCC
require include/picozed.inc

MACHINE_ESSENTIAL_EXTRA_RRECOMMENDS += "\
	kernel-modules \
	"
```

## yocto/meta-zynq/conf/machine/fixelplut-crz01-carrier-zynq7.conf
```bitbake
#@TYPE: Machine
#@NAME: fixelplut-crz01-carrier-zynq7
#@DESCRIPTION: Machine support for GVI-Tech CRZ01 on carrier with Pixelflut stuff
require include/crz01.inc

MACHINE_ESSENTIAL_EXTRA_RRECOMMENDS += "\
	kernel-modules \
	"
```

## yocto/meta-zynq/conf/machine/include/autocopter.inc
```bitbake
MACHINEOVERRIDES =. "autocopterall:"

# Add the userenv.txt which contains the list ob device tree overlays
IMAGE_BOOT_FILES += "\
	userenv.txt \
    "

# For easier kernel tinkering
MACHINE_ESSENTIAL_EXTRA_RRECOMMENDS += "\
    kernel-modules \
    "
```

## yocto/meta-zynq/conf/machine/include/common.inc
```bitbake
PREFERRED_PROVIDER_virtual/kernel ?= "linux-xlnx"
PREFERRED_VERSION_linux-xlnx ?= "4.19%"

require conf/machine/include/tune-zynq.inc
require conf/machine/include/machine-xilinx-overrides.inc
require conf/machine/include/machine-xilinx-default.inc

EXTRA_IMAGEDEPENDS += " \
    virtual/boot-bin \
    virtual/bootloader \
    bootscript \
    device-tree \
    "

IMAGE_BOOT_FILES = " \
    boot.bin \
    boot.scr \
    ${KERNEL_IMAGETYPE} \
    u-boot.itb \
    devicetree/${MACHINE_DEVICETREE}.dtb;devicetree/system.dtb \
    devicetree/*.dtbo;devicetree/ \
    "

IMAGE_FSTYPES += "wic wic.bmap"
WKS_FILES = "sdimage-bootpart.wks"
```

## yocto/meta-zynq/conf/machine/include/crz01.inc
```bitbake
include common.inc

MACHINE_FEATURES = "ext2 vfat usbhost"

MACHINEOVERRIDES =. "crz01all:"

UBOOT_MACHINE = "zynq_crz01_config"
FORCE_PLATFORM_INIT = "1"
SPL_BINARY = "spl/boot.bin"

SERIAL_CONSOLE = "115200 ttyPS0"

MACHINE_DEVICETREE = "crz01-carrier-zynq7"
```

## yocto/meta-zynq/conf/machine/include/microzed.inc
```bitbake
include common.inc

MACHINE_FEATURES = "ext2 vfat usbhost"

MACHINEOVERRIDES =. "microzedall:"

UBOOT_MACHINE = "zynq_microzed_config"
FORCE_PLATFORM_INIT = "1"
SPL_BINARY = "spl/boot.bin"

SERIAL_CONSOLE = "115200 ttyPS0"

MACHINE_DEVICETREE = "microzed-iocc-zynq7"
```

## yocto/meta-zynq/conf/machine/include/picozed.inc
```bitbake
include common.inc

MACHINE_FEATURES = "ext2 vfat usbhost"

MACHINEOVERRIDES =. "picozedall:"

UBOOT_MACHINE = "zynq_picozed_config"
FORCE_PLATFORM_INIT = "1"
SPL_BINARY = "spl/boot.bin"

SERIAL_CONSOLE = "115200 ttyPS0"

MACHINE_DEVICETREE = "picozed-pciecc-zynq7"
```
